## dts/bindings/clock/ti,stellaris-ccm.yaml
```yaml
#
# Copyright (c) 2018, Zilogic Systems.
# Copyright (c) 2020, PlayerData Holdings Ltd
#
# SPDX-License-Identifier: Apache-2.0
#

description: STELLARIS CCM

compatible: "ti,stellaris-ccm"

include: [clock-controller.yaml, base.yaml]

properties:
    reg:
      type: array
      description: mmio register space
      required: true

    label:
      type: string
      required: true
      description: Human readable string describing the device (used by Zephyr for API name)

clock-cells:
  - bus
  - enable
```

## dts/bindings/spi/arm,pl022.yaml
```yaml
#
# Copyright (c) 2018, Zilogic Systems
# Copyright (c) 2020, PlayerData Holdings Ltd
#
# SPDX-License-Identifier: Apache-2.0
#

description: ARM PL022 SPI Controller

compatible: "arm,pl022"

include: spi-controller.yaml

properties:
    reg:
      type: array
      description: mmio register space
      required: true

    interrupts:
      type: array
      required: true
      description: required interrupts
```

## tests/subsys/fs/fcb_pd_extensions/testcase.yaml
```yaml
tests:
  filesystem.fcb:
    platform_whitelist: nrf52840dk_nrf52840
    tags: flash_circural_buffer
```
